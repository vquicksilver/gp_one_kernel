## drivers/net/wireless/ar6k/Kconfig
```kconfig
config AR6K
        bool 'Atheros AR6002 SDIO driver'
        select WIRELESS_EXT
        ---help---
          Enable Atheros AR6002 driver.
config AR6K_FW_PATH
	depends on AR6K
	string "Firmware path"
	default "/system/etc/firmware/fw/"
	---help---
	  Path to the firmware file/s.
```

## drivers/video/msm/Kconfig
```kconfig
source "drivers/video/msm/vidc/Kconfig"

config FB_MSM
	tristate
	depends on FB && ARCH_MSM
	select FB_CFB_FILLRECT
	select FB_CFB_COPYAREA
	select FB_CFB_IMAGEBLIT
	default y

config FB_MSM_LCDC
	bool "Support for integrated LCD controller in qsd8x50"
	depends on FB_MSM && MSM_MDP31
	default y

config FB_MSM_REFRESH
       bool "Enable MSM Framebuffer Refresh Thread"
       depends on FB_MSM
       default n
       ---help---
         The refresh thread will constantly perform a full screen
         update. This is neccesary when using X with the default
         fbdev driver.


config FB_MSM_HX8352_SINGLE_BUFFER
	bool "if on enables single buffering for MSM Framebuffer when using hx8352"
	depends on FB_MSM
	default n
	---help---
	If enabled the framebuffer doesn't does double buffering, this is needed for Xorg + fbdev

config MSM_FB_ENABLE_DBGFS
	bool "Enable MSM debug filesystem support and other verbose messages"
	depends on FB_MSM
	default n
```
